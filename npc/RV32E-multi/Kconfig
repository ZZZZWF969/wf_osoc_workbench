## npc/RV32E-multi/Kconfig
```kconfig
mainmenu "NPC Configuration"

config NPC_TRACE
	bool "Enable tracer"
	default n

config NPC_ITRACE
	depends on NPC_TRACE
	bool "Enable instruction tracer"
	default n

config NPC_MTRACE
	depends on NPC_TRACE
	bool "Enable memory tracer"
	default n

config NPC_WAVE
	bool "Enable waveform"
	default n

config NPC_DIFFTEST
	bool "Enable difftest"
	default n

config NPC_WATCHPOINT
	bool "Enable watchpoint"
	default n
```

## npc/RV32E-single/configs/defconfig
```kconfig
CONFIG_NPC_TRACE=y
CONFIG_NPC_ITRACE=y
CONFIG_NPC_DIFFTEST=y
CONFIG_NPC_WATCHPOINT=y
CONFIG_NPC_WAVE=y
```

## npc/RV32E/Kconfig
```kconfig
mainmenu "NPC Configuration"

config NPC_TRACE
	bool "Enable tracer"
	default y

config NPC_ITRACE
	depends on NPC_TRACE
	bool "Enable instruction tracer"
	default y

config NPC_MTRACE
	depends on NPC_TRACE
	bool "Enable memory tracer"
	default n

config NPC_WAVE
	bool "Enable waveform"
	default y

config NPC_DIFFTEST
	bool "Enable difftest"
	default y

config NPC_WATCHPOINT
	bool "Enable watchpoint"
	default y
```
